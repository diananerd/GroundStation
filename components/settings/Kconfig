## components/settings/Kconfig
```kconfig
menu "Board Settings"

config STORAGE_NAMESPACE
    string
    default "SETTINGS"
    help
	Name of the settings namespece in NVS

endmenu
```

## main/Kconfig
```kconfig
menu "Ground Station Configuration"
    config BASE_FIRMWARE_URL
        string "Base URL para el bucket del firmware"
        default "https://platzi-ground-station-beta.s3.us-east-2.amazonaws.com"
        help 
            Base URL para el bucket del firmware
    config API_BASE_URL
        string "Base URL para el API de mensajes recibidos"
        default "https://api-sls.platzi.com/prod/space-api"
        help
            Base URL para el API de mensajes recibidos
endmenu
```
